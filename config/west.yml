## config/west.yml
```yaml
manifest:
  remotes:
    - name: zmkfirmware
      url-base: https://github.com/zmkfirmware
      # Additional modules containing boards/shields/custom code can be listed here as well.
      # See:
      # - https://zmk.dev/docs/features/modules
      # - https://docs.zephyrproject.org/3.5.0/develop/west/manifest.html#projects
    - name: dsifry 
      url-base: https://github.com/dsifry 
    # - name: gpeye
    # url-base: https://github.com/GPeye
    #- name: urob
    #  url-base: https://github.com/urob
  projects:
    - name: eyelash_sofle
      url: https://github.com/a741725193/zmk-sofle
      #revision: refactor
      revision: main
    #- name: mario-peripheral-animation
    #- name: hammerbeam-slideshow
    #  remote: gpeye
    #  revision: main 
    - name: zmk
      remote: zmkfirmware
      revision: main
      import: app/west.yml
    # - name: zmk-auto-layer
    #   remote: urob
    #   revision: main
    - name: nice-view-mod #new entry
      remote: dsifry #new entry
      revision: main #new entry
  self:
    path: config
```
